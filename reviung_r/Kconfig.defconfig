## reviung_r/Kconfig.defconfig
```kconfig
# Copyright (c) 2020 The ZMK Contributors
# SPDX-License-Identifier: MIT

if SHIELD_REVIUNG_R

config ZMK_KEYBOARD_NAME
    default "Reviung_R"

endif
```

## reviung_r/Kconfig.shield
```kconfig
# Copyright (c) 2020 The ZMK Contributors
# SPDX-License-Identifier: MIT

config SHIELD_REVIUNG_R
    def_bool $(shields_list_contains,reviung_r)
```
